/**
 * These arguments were used when this file was generated. They will be automatically applied on subsequent loads
 * via the GUI or CLI. Run CLI with '--help' for additional information on how to override these arguments.
 * @cliArgs --device "F2838x" --package "337bga" --part "F2838x_337bga" --context "CPU2" --product "C2000WARE@4.03.00.00"
 * @versions {"tool":"1.15.999+71"}
 */