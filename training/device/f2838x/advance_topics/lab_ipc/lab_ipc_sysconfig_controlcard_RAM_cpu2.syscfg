/**
 * @cliArgs --device "F2838x" --package "337bga" --part "F2838x_337bga" --context "CPU2" --product "C2000WARE@4.03.00.00"
 * @versions {"tool":"1.15.999+71"}
 */

/**
 * Import the modules used in this configuration.
 */
const ipc  = scripting.addModule("/driverlib/ipc.js");
const CMD  = scripting.addModule("/utilities/cmd_tool/cmd_syscfg/source/CMD");
const CMD1 = CMD.addInstance();

/**
 * Write custom configuration values to the imported modules.
 */
ipc.ipcRegisterFlag          = ["IPC_FLAG1","IPC_FLAG31"];
ipc.enableInterrupt1         = true;
ipc.flagHandler31            = "IPC_SYNC";
ipc.registerInterrupts       = ["0"];
ipc.ipcInt0.interruptHandler = "ipc0_ISR";
ipc.ipcInt0.enableInterrupt  = true;

CMD.activateCMD = true;

CMD1.$name                    = "CMD0";
CMD1.sectionMemory_text       = ["RAMD0","RAMD1","RAMLS0","RAMLS1","RAMLS2","RAMLS3"];
CMD1.sectionMemory_ramfunc    = ["RAMM0"];
CMD1.sectionMemory_cinit      = ["RAMM0"];
CMD1.sectionMemory_init_array = ["RAMM0"];
CMD1.sectionMemory_const      = ["RAMLS5"];
CMD1.sectionMemory_switch     = ["RAMM0"];
CMD1.sectionMemory_stack      = ["RAMM1"];
CMD1.sectionMemory_bss        = ["RAMLS5"];
CMD1.sectionMemory_data       = ["RAMLS5"];
CMD1.sectionMemory_sysmem     = ["RAMLS5"];
CMD1.sectionAlignEnable_binit = true;
CMD1.sectionMemory_binit      = ["FLASH0"];
