/**
 * @cliArgs --board "/boards/LAUNCHXL_F2800137" --context "system" --product "C2000WARE@4.02.00.00"
 * @versions {"tool":"1.15.0+2826"}
 */

/**
 * Import the modules used in this configuration.
 */
const adc       = scripting.addModule("/driverlib/adc.js", {}, false);
const adc1      = adc.addInstance();
const analog    = scripting.addModule("/driverlib/analog.js", {}, false);
const analog1   = analog.addInstance();
const asysctl   = scripting.addModule("/driverlib/asysctl.js");
const led       = scripting.addModule("/driverlib/board_components/led", {}, false);
const led1      = led.addInstance();
const cmpss     = scripting.addModule("/driverlib/cmpss.js", {}, false);
const cmpss1    = cmpss.addInstance();
const epwm      = scripting.addModule("/driverlib/epwm.js", {}, false);
const epwm1     = epwm.addInstance();
const epwmxbar  = scripting.addModule("/driverlib/epwmxbar.js", {}, false);
const epwmxbar1 = epwmxbar.addInstance();

/**
 * Write custom configuration values to the imported modules.
 */
adc1.adcClockPrescaler       = "ADC_CLK_DIV_4_0";
adc1.interruptPulseMode      = "ADC_PULSE_END_OF_CONV";
adc1.registerInterrupts      = ["1"];
adc1.enabledInts             = ["ADC_INT_NUMBER1"];
adc1.enableInterrupt1        = true;
adc1.enabledSOCs             = ["ADC_SOC_NUMBER0"];
adc1.soc0Channel             = "ADC_CH_ADCIN2";
adc1.soc0Trigger             = "ADC_TRIGGER_EPWM1_SOCA";
adc1.soc0InterruptTrigger    = "ADC_INT_SOC_TRIGGER_ADCINT1";
adc1.soc0SampleWindow        = 15;
adc1.$name                   = "myADCA";
adc1.adcInt1.enableInterrupt = true;

asysctl.analogReference        = "INTERNAL";
asysctl.analogReferenceVoltage = "1P65";

led1.$name     = "myBoardLED0";
led1.$hardware = system.deviceData.board.components.LED5;

cmpss1.enableModule = true;
cmpss1.$name        = "myCMPSS";
cmpss1.dacValHigh   = 2500;

analog1.$name                                = "myANALOGPinMux0";
adc1.analog                                  = analog1;
cmpss1.analog                                = analog1;
analog1.analog["a16/c16, gpio28Pin"].$assign = "boosterpack1.3";
analog1.analog["a17/c17, gpio20Pin"].$assign = "boosterpack2.53";
analog1.analog["a19/c19, gpio13Pin"].$assign = "boosterpack2.79";
analog1.analog["a20/c20, gpio12Pin"].$assign = "boosterpack2.80";
analog1.analog["a8/c11Pin"].$assign          = "boosterpack2.65";
scripting.suppress("Connected to hardware,@@@.+?@@@ is connected to SCIA XDS on the LaunchPad F2800137\\. Consider selecting it in 'use hardware' above\\. @@@.+?@@@", analog1.analog, "a16/c16, gpio28Pin");
scripting.suppress("Connected to hardware,@@@.+?@@@ is connected to LED4 \\(User LEDs\\) on the LaunchPad F2800137\\. Consider selecting it in 'use hardware' above\\. @@@.+?@@@", analog1.analog, "a17/c17, gpio20Pin");
scripting.suppress("Connected to hardware,@@@.+?@@@ is connected to EPWM7 BP on the LaunchPad F2800137\\. Consider selecting it in 'use hardware' above\\. @@@.+?@@@", analog1.analog, "a19/c19, gpio13Pin");
scripting.suppress("Connected to hardware,@@@.+?@@@ is connected to EPWM7 BP on the LaunchPad F2800137\\. Consider selecting it in 'use hardware' above\\. @@@.+?@@@", analog1.analog, "a20/c20, gpio12Pin");

epwm1.$name                                                      = "myEPWM1";
epwm1.epwmTimebase_hsClockDiv                                    = "EPWM_HSCLOCK_DIVIDER_1";
epwm1.epwmTimebase_counterMode                                   = "EPWM_COUNTER_MODE_UP_DOWN";
epwm1.epwmTimebase_period                                        = 1000;
epwm1.epwmCounterCompare_cmpA                                    = 500;
epwm1.epwmActionQualifier_EPWM_AQ_OUTPUT_A_ON_TIMEBASE_UP_CMPA   = "EPWM_AQ_OUTPUT_HIGH";
epwm1.epwmActionQualifier_EPWM_AQ_OUTPUT_A_ON_TIMEBASE_DOWN_CMPA = "EPWM_AQ_OUTPUT_LOW";
epwm1.epwmDigitalCompare_EPWM_DC_TYPE_DCAH                       = "EPWM_DC_TRIP_TRIPIN4";
epwm1.epwmDigitalCompare_EPWM_TZ_DC_OUTPUT_A1                    = "EPWM_TZ_EVENT_DCXH_HIGH";
epwm1.epwmTripZone_EPWM_TZ_ACTION_EVENT_TZA                      = "EPWM_TZ_ACTION_LOW";
epwm1.epwmTripZone_oneShotSource                                 = ["EPWM_TZ_SIGNAL_DCAEVT1"];
epwm1.epwmEventTrigger_EPWM_SOC_A_triggerEnable                  = true;
epwm1.epwmEventTrigger_EPWM_SOC_A_triggerSource                  = "EPWM_SOC_TBCTR_U_CMPA";
epwm1.epwmEventTrigger_EPWM_SOC_A_triggerEventPrescalar          = "1";
epwm1.epwm.$assign                                               = "EPWM1";
epwm1.epwm.epwm_aPin.$assign                                     = "boosterpack1.40";
epwm1.epwm.epwm_bPin.$assign                                     = "boosterpack1.39";
epwm1.aQual.$name                                                = "myGPIOQUAL0";
epwm1.bQual.$name                                                = "myGPIOQUAL1";
scripting.suppress("Connected to hardware,@@@.+?@@@ is connected to EPWM1 BP on the LaunchPad F2800137\\. Consider selecting it in 'use hardware' above\\. @@@.+?@@@", epwm1.epwm, "epwm_aPin");
scripting.suppress("Connected to hardware,@@@.+?@@@ is connected to EPWM1 BP on the LaunchPad F2800137\\. Consider selecting it in 'use hardware' above\\. @@@.+?@@@", epwm1.epwm, "epwm_bPin");

epwmxbar1.$name     = "myEPWMXBAR4";
epwmxbar1.muxesUsed = ["XBAR_MUX00"];

/**
 * Pinmux solution for unlocked pins/peripherals. This ensures that minor changes to the automatic solver in a future
 * version of the tool will not impact the pinmux you originally saw.  These lines can be completely deleted in order to
 * re-solve from scratch.
 */
led1.gpio.gpioPin.$suggestSolution                     = "boosterpack1.12";
analog1.analog.$suggestSolution                        = "ANALOG";
analog1.analog["a0/c15/cmp1_daclPin"].$suggestSolution = "boosterpack2.69";
analog1.analog.a1Pin.$suggestSolution                  = "boosterpack2.42";
analog1.analog["a10/c10, gpio230Pin"].$suggestSolution = "boosterpack2.68";
analog1.analog["a11/c0Pin"].$suggestSolution           = "boosterpack1.28";
analog1.analog["a12/c1Pin"].$suggestSolution           = "boosterpack1.29";
analog1.analog["a15/c7Pin"].$suggestSolution           = "boosterpack1.26";
analog1.analog["a18/c18, gpio21Pin"].$suggestSolution  = "boosterpack2.74";
analog1.analog["a2/c9, gpio224Pin"].$suggestSolution   = "boosterpack1.25";
analog1.analog["a3/c5, gpio242Pin"].$suggestSolution   = "boosterpack1.24";
analog1.analog["a4/c14Pin"].$suggestSolution           = "boosterpack2.66";
analog1.analog["a5/c2Pin"].$suggestSolution            = "boosterpack2.63";
analog1.analog["a6, gpio228Pin"].$suggestSolution      = "boosterpack1.23";
analog1.analog["a7/c3Pin"].$suggestSolution            = "boosterpack2.64";
analog1.analog["c4/a14Pin"].$suggestSolution           = "boosterpack1.27";
analog1.analog["c6, gpio226Pin"].$suggestSolution      = "boosterpack1.2";
analog1.analog["c8/a9, gpio227Pin"].$suggestSolution   = "boosterpack2.67";
