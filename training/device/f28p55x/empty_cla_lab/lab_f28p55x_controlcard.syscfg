/**
 * These arguments were used when this file was generated. They will be automatically applied on subsequent loads
 * via the GUI or CLI. Run CLI with '--help' for additional information on how to override these arguments.
 * @cliArgs --board "/boards/TMDSCNCD28P55X" --context "system" --product "C2000WARE@5.00.00.00"
 * @versions {"tool":"1.19.0+3239"}
 */
