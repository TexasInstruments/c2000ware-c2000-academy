/**
 * @cliArgs --board "/boards/LAUNCHXL_F28P55X" --context "system" --product "C2000WARE@5.02.00.00"
 * @versions {"tool":"1.19.0+3288"}
 */

/**
 * Import the modules used in this configuration.
 */
const led       = scripting.addModule("/driverlib/board_components/led", {}, false);
const led1      = led.addInstance();
const cputimer  = scripting.addModule("/driverlib/cputimer.js", {}, false);
const cputimer1 = cputimer.addInstance();
const sci       = scripting.addModule("/driverlib/sci.js", {}, false);
const sci1      = sci.addInstance();

/**
 * Write custom configuration values to the imported modules.
 */
led1.$name                = "myBoardLED0";
led1.$hardware            = system.deviceData.board.components.LED5;
led1.gpio.gpioPin.$assign = "boosterpack1.13";

cputimer1.$name                    = "myCPUTIMER0";
cputimer1.timerPrescaler           = 1;
cputimer1.timerPeriod              = 200000000;
cputimer1.registerInterrupts       = true;
cputimer1.enableInterrupt          = true;
cputimer1.timerInt.enableInterrupt = true;

sci1.$name                 = "mySCIA";
sci1.baudRates             = 9600;
sci1.sci.$assign           = "SCIA";
sci1.sci.sci_rxPin.$assign = "boosterpack1.3";
sci1.sci.sci_txPin.$assign = "boosterpack1.4";
scripting.suppress("Connected to hardware,@@@.+?@@@ is connected to SCIA XDS on the LaunchPad F28P55X\\. Consider selecting it in 'use hardware' above\\. @@@.+?@@@", sci1.sci, "sci_rxPin");
scripting.suppress("Connected to hardware,@@@.+?@@@ is connected to SCIA XDS on the LaunchPad F28P55X\\. Consider selecting it in 'use hardware' above\\. @@@.+?@@@", sci1.sci, "sci_txPin");
