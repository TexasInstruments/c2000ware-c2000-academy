/**
 * @cliArgs --board "/boards/TMDSCNCD280039C" --product "C2000WARE@4.01.00.00"
 * @versions {"tool":"1.11.0+2225"}
 */

/**
 * Import the modules used in this configuration.
 */
const adc        = scripting.addModule("/driverlib/adc.js", {}, false);
const adc1       = adc.addInstance();
const asysctl    = scripting.addModule("/driverlib/asysctl.js");
const led        = scripting.addModule("/driverlib/board_components/led", {}, false);
const led1       = led.addInstance();
const ecap       = scripting.addModule("/driverlib/ecap.js", {}, false);
const ecap1      = ecap.addInstance();
const epwm       = scripting.addModule("/driverlib/epwm.js", {}, false);
const epwm1      = epwm.addInstance();
const epwm2      = epwm.addInstance();
const inputxbar  = scripting.addModule("/driverlib/inputxbar.js", {}, false);
const inputxbar1 = inputxbar.addInstance();

/**
 * Write custom configuration values to the imported modules.
 */
adc1.$name                          = "myADC0";
adc1.adcClockPrescaler              = "ADC_CLK_DIV_4_0";
adc1.enabledSOCs                    = ["ADC_SOC_NUMBER0"];
adc1.enabledInts                    = ["ADC_INT_NUMBER1"];
adc1.enableInterrupt1               = true;
adc1.enableInterrupt1ContinuousMode = true;
adc1.registerInterrupts             = ["1"];
adc1.soc0Trigger                    = "ADC_TRIGGER_EPWM2_SOCA";
adc1.soc0SampleWindow               = 8;
adc1.interruptPulseMode             = "ADC_PULSE_END_OF_CONV";
adc1.adcInt1.interruptHandler       = "adcA1ISR";
adc1.adcInt1.enableInterrupt        = true;

const analog  = scripting.addModule("/driverlib/analog.js", {}, false);
const analog1 = analog.addInstance({}, false);
analog1.$name = "myANALOGPinMux0";
adc1.analog   = analog1;

asysctl.analogReference = "INTERNAL";

led1.$name      = "myBoardLED0";
led1.$hardware  = system.deviceData.board.components.D2;
led1.gpio.$name = "myBoardLED0_GPIO";

ecap1.$name                    = "myECAP0";
ecap1.eventStop                = "ECAP_EVENT_4";
ecap1.eventTwoPolarity         = "ECAP_EVNT_FALLING_EDGE";
ecap1.eventFourPolarity        = "ECAP_EVNT_FALLING_EDGE";
ecap1.registerInterrupts       = true;
ecap1.enableInterrupt          = true;
ecap1.interruptSourceCapture   = ["ECAP_ISR_SOURCE_CAPTURE_EVENT_3"];
ecap1.ecapInput                = "ECAP_INPUT_INPUTXBAR7";
ecap1.ecapInt.interruptHandler = "ecap1ISR";
ecap1.ecapInt.enableInterrupt  = true;

epwm1.$name                                                      = "myEPWM0";
epwm1.epwmTimebase_counterMode                                   = "EPWM_COUNTER_MODE_UP_DOWN";
epwm1.epwmCounterCompare_cmpA                                    = 18750;
epwm1.epwmTimebase_period                                        = 25000;
epwm1.epwmActionQualifier_EPWM_AQ_OUTPUT_A_shadowMode            = true;
epwm1.epwmActionQualifier_EPWM_AQ_OUTPUT_A_ON_TIMEBASE_UP_CMPA   = "EPWM_AQ_OUTPUT_HIGH";
epwm1.epwmActionQualifier_EPWM_AQ_OUTPUT_A_ON_TIMEBASE_DOWN_CMPA = "EPWM_AQ_OUTPUT_LOW";
epwm1.epwmActionQualifier_EPWM_AQ_OUTPUT_A_usedEvents            = ["EPWM_AQ_OUTPUT_ON_TIMEBASE_DOWN_CMPA","EPWM_AQ_OUTPUT_ON_TIMEBASE_UP_CMPA"];
epwm1.epwm.$assign                                               = "EPWM1";
epwm1.epwm.epwm_aPin.$assign                                     = "hsecDigital.49";
epwm1.epwm.epwm_bPin.$assign                                     = "hsecDigital.51";

epwm2.$name                                             = "myEPWM2";
epwm2.epwmTimebase_period                               = 1999;
epwm2.epwmTimebase_counterMode                          = "EPWM_COUNTER_MODE_UP";
epwm2.epwmEventTrigger_EPWM_SOC_A_triggerEnable         = true;
epwm2.epwmEventTrigger_EPWM_SOC_A_triggerSource         = "EPWM_SOC_TBCTR_PERIOD";
epwm2.epwmEventTrigger_EPWM_SOC_A_triggerEventPrescalar = "1";
epwm2.epwm.$assign                                      = "EPWM2";
epwm2.epwm.epwm_aPin.$assign                            = "hsecDigital.53";
epwm2.epwm.epwm_bPin.$assign                            = "hsecDigital.55";

inputxbar1.$name          = "myINPUTXBAR0";
inputxbar1.inputsUsed     = ["inputxbar7Gpio"];
inputxbar1.inputxbar7Gpio = "GPIO0";

/**
 * Pinmux solution for unlocked pins/peripherals. This ensures that minor changes to the automatic solver in a future
 * version of the tool will not impact the pinmux you originally saw.  These lines can be completely deleted in order to
 * re-solve from scratch.
 */
analog1.analog.$suggestSolution                           = "ANALOG";
analog1.analog["a0/b15/c15/daca_outPin"].$suggestSolution = "hsecAnalog.9";
analog1.analog["a1/b7/dacb_outPin"].$suggestSolution      = "hsecAnalog.11";
analog1.analog["a10/b1/c10Pin"].$suggestSolution          = "hsecAnalog.25";
analog1.analog["a11/b10/c0Pin"].$suggestSolution          = "hsecAnalog.27";
analog1.analog["a12, c5Pin"].$suggestSolution             = "hsecAnalog.37";
analog1.analog["a14/b14/c4Pin"].$suggestSolution          = "hsecAnalog.36";
analog1.analog["a2/b6/c9Pin"].$suggestSolution            = "hsecAnalog.15";
analog1.analog["a3, c7/b9Pin"].$suggestSolution           = "hsecAnalog.39";
analog1.analog["a4/b8Pin"].$suggestSolution               = "hsecAnalog.17";
analog1.analog.a5Pin.$suggestSolution                     = "hsecAnalog.21";
analog1.analog.a6Pin.$suggestSolution                     = "hsecAnalog.23";
analog1.analog.a8Pin.$suggestSolution                     = "hsecAnalog.30";
analog1.analog.a9Pin.$suggestSolution                     = "hsecAnalog.34";
analog1.analog["b0/c11Pin"].$suggestSolution              = "hsecAnalog.31";
analog1.analog.b11Pin.$suggestSolution                    = "hsecAnalog.24";
analog1.analog["b11, gpio21Pin"].$suggestSolution         = "hsecDigital.70";
analog1.analog["b2/c6Pin"].$suggestSolution               = "hsecAnalog.14";
analog1.analog["b3/vdacPin"].$suggestSolution             = "hsecAnalog.12";
analog1.analog["b4/c8Pin"].$suggestSolution               = "hsecAnalog.20";
analog1.analog.b5Pin.$suggestSolution                     = "hsecAnalog.26";
analog1.analog["b5, gpio20Pin"].$suggestSolution          = "hsecDigital.68";
analog1.analog.c1Pin.$suggestSolution                     = "hsecAnalog.28";
analog1.analog.c14Pin.$suggestSolution                    = "hsecAnalog.40";
analog1.analog["c2/b12Pin"].$suggestSolution              = "hsecAnalog.18";
analog1.analog["c3/a7Pin"].$suggestSolution               = "hsecAnalog.33";
led1.gpio.gpioPin.$suggestSolution                        = "hsecDigital.86";
