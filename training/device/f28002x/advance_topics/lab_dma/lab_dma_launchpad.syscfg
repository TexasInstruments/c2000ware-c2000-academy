/**
 * @cliArgs --board "/boards/LAUNCHXL_F280025C" --context "system" --product "C2000WARE@4.02.00.00"
 * @versions {"tool":"1.13.0+2553"}
 */

/**
 * Import the modules used in this configuration.
 */
const adc              = scripting.addModule("/driverlib/adc.js", {}, false);
const adc1             = adc.addInstance();
const asysctl          = scripting.addModule("/driverlib/asysctl.js");
const led              = scripting.addModule("/driverlib/board_components/led", {}, false);
const led1             = led.addInstance();
const cputimer         = scripting.addModule("/driverlib/cputimer.js", {}, false);
const cputimer1        = cputimer.addInstance();
const dma              = scripting.addModule("/driverlib/dma.js", {}, false);
const dma1             = dma.addInstance();
const epwm             = scripting.addModule("/driverlib/epwm.js", {}, false);
const epwm1            = epwm.addInstance();
const epwm2            = epwm.addInstance();
const inputxbar        = scripting.addModule("/driverlib/inputxbar.js", {}, false);
const inputxbar1       = inputxbar.addInstance();
const inputxbar_input  = scripting.addModule("/driverlib/inputxbar_input.js");
const inputxbar_input1 = inputxbar_input.addInstance();

/**
 * Write custom configuration values to the imported modules.
 */
adc1.$name                          = "myADC0";
adc1.adcClockPrescaler              = "ADC_CLK_DIV_4_0";
adc1.enabledSOCs                    = ["ADC_SOC_NUMBER0"];
adc1.soc0Trigger                    = "ADC_TRIGGER_EPWM2_SOCA";
adc1.soc0SampleWindow               = 8;
adc1.interruptPulseMode             = "ADC_PULSE_END_OF_CONV";
adc1.enabledInts                    = ["ADC_INT_NUMBER1"];
adc1.enableInterrupt1               = true;
adc1.enableInterrupt1ContinuousMode = true;

const analog  = scripting.addModule("/driverlib/analog.js", {}, false);
const analog1 = analog.addInstance({}, false);
analog1.$name = "myANALOGPinMux0";
adc1.analog   = analog1;

asysctl.analogReference = "INTERNAL";

led1.$name     = "myBoardLED0";
led1.$hardware = system.deviceData.board.components.LED5;

cputimer1.$name       = "myCPUTIMER0";
cputimer1.timerPeriod = 4294967295;

dma1.$name                   = "myDMA0";
dma1.enableTriggers          = true;
dma1.triggerSource           = "DMA_TRIGGER_ADCA1";
dma1.useInterrupts           = true;
dma1.registerInterrupts      = true;
dma1.enableInterrupts        = true;
dma1.continuousModeConfig    = "DMA_CFG_CONTINUOUS_ENABLE";
dma1.srcAddressInputMode     = "VARIABLE";
dma1.srcAddressVariable      = "AdcAddr";
dma1.destAddressInputMode    = "VARIABLE";
dma1.destAddressVariable     = "AdcRawBufAddr";
dma1.transferSize            = 50;
dma1.destTransferStep        = 1;
dma1.startChannel            = true;
dma1.emulationMode           = "DMA_EMULATION_FREE_RUN";
dma1.srcWrapSize             = 50;
dma1.destWrapSize            = 50;
dma1.dmaInt.interruptHandler = "dma_Ch1ISR";
dma1.dmaInt.enableInterrupt  = true;

epwm1.$name                                                      = "myEPWM0";
epwm1.epwmTimebase_counterMode                                   = "EPWM_COUNTER_MODE_UP_DOWN";
epwm1.epwmTimebase_period                                        = 25000;
epwm1.epwmCounterCompare_cmpA                                    = 18750;
epwm1.epwmActionQualifier_EPWM_AQ_OUTPUT_A_ON_TIMEBASE_UP_CMPA   = "EPWM_AQ_OUTPUT_HIGH";
epwm1.epwmActionQualifier_EPWM_AQ_OUTPUT_A_ON_TIMEBASE_DOWN_CMPA = "EPWM_AQ_OUTPUT_LOW";
epwm1.epwmActionQualifier_EPWM_AQ_OUTPUT_A_shadowMode            = true;
epwm1.epwmActionQualifier_EPWM_AQ_OUTPUT_A_usedEvents            = ["EPWM_AQ_OUTPUT_ON_TIMEBASE_DOWN_CMPA","EPWM_AQ_OUTPUT_ON_TIMEBASE_UP_CMPA"];
epwm1.epwm.$assign                                               = "EPWM1";
epwm1.epwm.epwm_aPin.$assign                                     = "boosterpack1.40";
epwm1.epwm.epwm_bPin.$assign                                     = "boosterpack1.39";
epwm1.aQual.$name                                                = "myGPIOQUAL0";
epwm1.bQual.$name                                                = "myGPIOQUAL1";
scripting.suppress("Connected to hardware,@@@.+?@@@ is connected to EPWM1 BP on the LaunchPad F280025C\. Consider selecting it in 'use hardware' above\. @@@.+?@@@", epwm1.epwm, "epwm_aPin");
scripting.suppress("Connected to hardware,@@@.+?@@@ is connected to EPWM1 BP on the LaunchPad F280025C\. Consider selecting it in 'use hardware' above\. @@@.+?@@@", epwm1.epwm, "epwm_bPin");

epwm2.$name                                             = "myEPWM1";
epwm2.epwmTimebase_counterMode                          = "EPWM_COUNTER_MODE_UP";
epwm2.epwmTimebase_period                               = 1999;
epwm2.epwmEventTrigger_EPWM_SOC_A_triggerEnable         = true;
epwm2.epwmEventTrigger_EPWM_SOC_A_triggerSource         = "EPWM_SOC_TBCTR_PERIOD";
epwm2.epwmEventTrigger_EPWM_SOC_A_triggerEventPrescalar = "1";
epwm2.epwm.$assign                                      = "EPWM2";
epwm2.epwm.epwm_aPin.$assign                            = "boosterpack1.38";
epwm2.epwm.epwm_bPin.$assign                            = "boosterpack1.37";
epwm2.aQual.$name                                       = "myGPIOQUAL2";
epwm2.bQual.$name                                       = "myGPIOQUAL3";
scripting.suppress("Connected to hardware,@@@.+?@@@ is connected to EPWM2 BP on the LaunchPad F280025C\. Consider selecting it in 'use hardware' above\. @@@.+?@@@", epwm2.epwm, "epwm_aPin");
scripting.suppress("Connected to hardware,@@@.+?@@@ is connected to EPWM2 BP on the LaunchPad F280025C\. Consider selecting it in 'use hardware' above\. @@@.+?@@@", epwm2.epwm, "epwm_bPin");

inputxbar1.$name = "myINPUTXBAR0";

inputxbar_input1.$name          = "myINPUTXBARINPUT0";
inputxbar_input1.inputxbarInput = "XBAR_INPUT7";
inputxbar_input1.inputxbarGpio  = "GPIO0";

/**
 * Pinmux solution for unlocked pins/peripherals. This ensures that minor changes to the automatic solver in a future
 * version of the tool will not impact the pinmux you originally saw.  These lines can be completely deleted in order to
 * re-solve from scratch.
 */
analog1.analog.$suggestSolution                  = "ANALOG";
analog1.analog["a0/c15Pin"].$suggestSolution     = "boosterpack2.69";
analog1.analog.a1Pin.$suggestSolution            = "boosterpack2.42";
analog1.analog["a10/c10Pin"].$suggestSolution    = "boosterpack2.68";
analog1.analog["a11/c0Pin"].$suggestSolution     = "boosterpack1.28";
analog1.analog["a12/c1Pin"].$suggestSolution     = "boosterpack1.29";
analog1.analog["a14/c4Pin"].$suggestSolution     = "boosterpack1.27";
analog1.analog["a15/c7Pin"].$suggestSolution     = "boosterpack1.26";
analog1.analog["a2/c9Pin"].$suggestSolution      = "boosterpack1.25";
analog1.analog["a3/c5/vdacPin"].$suggestSolution = "boosterpack1.24";
analog1.analog["a4/c14Pin"].$suggestSolution     = "boosterpack2.66";
analog1.analog["a5/c2Pin"].$suggestSolution      = "boosterpack2.63";
analog1.analog.a6Pin.$suggestSolution            = "boosterpack1.23";
analog1.analog["a7/c3Pin"].$suggestSolution      = "boosterpack2.64";
analog1.analog["a8/c11Pin"].$suggestSolution     = "boosterpack2.65";
analog1.analog["a9/c8Pin"].$suggestSolution      = "boosterpack2.67";
analog1.analog.c6Pin.$suggestSolution            = "boosterpack1.2";
led1.gpio.gpioPin.$suggestSolution               = "boosterpack1.8";
